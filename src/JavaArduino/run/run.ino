#include <Adafruit_NeoPixel.h>
#ifdef __AVR__
  #include <avr/power.h>
#endif

#define PIN 6

// Parameter 1 = number of pixels in strip
// Parameter 2 = Arduino pin number (most are valid)
// Parameter 3 = pixel type flags, add together as needed:
//   NEO_KHZ800  800 KHz bitstream (most NeoPixel products w/WS2812 LEDs)
//   NEO_KHZ400  400 KHz (classic 'v1' (not v2) FLORA pixels, WS2811 drivers)
//   NEO_GRB     Pixels are wired for GRB bitstream (most NeoPixel products)
//   NEO_RGB     Pixels are wired for RGB bitstream (v1 FLORA pixels, not v2)
//   NEO_RGBW    Pixels are wired for RGBW bitstream (NeoPixel RGBW products)
Adafruit_NeoPixel strip = Adafruit_NeoPixel(74*44, PIN, NEO_GRB + NEO_KHZ800);

// IMPORTANT: To reduce NeoPixel burnout risk, add 1000 uF capacitor across
// pixel power leads, add 300 - 500 Ohm resistor on first pixel's data input
// and minimize distance between Arduino and first pixel.  Avoid connecting
// on a live circuit...if you must, connect GND first.

int xmax = 73;
int ymax = 43;


char c[1024];
boolean tmp=false;

void setup() {
  Serial.begin(250000);
  digitalWrite(13, LOW);
  delay(2500);
  // This is for Trinket 5V 16MHz, you can remove these three lines if you are not using a Trinket
  #if defined (__AVR_ATtiny85__)
    if (F_CPU == 16000000) clock_prescale_set(clock_div_1);
  #endif
  // End of trinket special code

  strip.begin();
  strip.setBrightness(32);
  strip.show();
  for (int rr = 0; rr <= ymax; rr++) {
    for (int cc=0; cc <= xmax; cc++) {
      strip.setPixelColor(toLEDNum(rr, cc), strip.Color(0, 0, 0));      
    }
  }
  strip.show(); // Initialize all pixels to 'off'
}


boolean setupB=true;
void loop() {
  while (Serial.available() > 0) {
    int n=Serial.readBytes(c, 1);
    if(c[0]=='P') {
      int row=Serial.parseInt();
      int col=Serial.parseInt();
      int r=Serial.parseInt();
      int g=Serial.parseInt();
      int b=Serial.parseInt();
      strip.setPixelColor(toLEDNum(row, col), strip.Color(r, g, b));
      //Serial.write("P1");
    }
    else if(c[0]=='X') {
      int row=Serial.parseInt();
      int col=Serial.parseInt();
      int w=Serial.parseInt();
      int h=Serial.parseInt();
      for (r=0; r<h; r++) {
        for (c=0; c<w; c++) {
            int red = Serial.parseInt();
            int green = Serial.parseInt();
            int blue = Serial.parseInt();
            strip.setPixelColor(toLEDNum(row+r, col+c), strip.Color(red, green, blue);
        }
      }
    }
    else if(c[0]=='E') {
      strip.show();
      //Serial.write("E1");
    }
    else if(c[0]=='D') {
      for(int rr=0; rr<=ymax; rr++) {
        for(int cc=0; cc<=xmax; cc++) {
          strip.setPixelColor(toLEDNum(rr, cc), strip.Color(0, 0, 0));      
        }
      }
      //Serial.write("D1");
    }
    else if(c[0]=='R') {
      //send("R "+row+" "+col+" "+w+" "+h+" "+h+" "+r+" "+g+" "+b+" "+i);
      int row=Serial.parseInt();
      int col=Serial.parseInt();
      int w=Serial.parseInt();
      int h=Serial.parseInt();
      int r=Serial.parseInt();
      int g=Serial.parseInt();
      int b=Serial.parseInt();
      int f=Serial.parseInt();
      if(f==0) {
        colorRect(row, col, w, h, r, g, b, false);
      }
      else {
        colorRect(row, col, w, h, r, g, b, true);
      }
    }
    else if(c[0]=='C') {
      //send("C "+row+" "+col+" "+radius+" "+r+" "+g+" "+b+" "+i);
      int row=Serial.parseInt();
      int col=Serial.parseInt();
      int radius=Serial.parseInt();
      int r=Serial.parseInt();
      int g=Serial.parseInt();
      int b=Serial.parseInt();
      int f=Serial.parseInt();
      if(f==0) {
        drawCircle(row, col, radius, r, g, b, false);
      }
      else {
        drawCircle(row, col, radius, r, g, b, true);
      }
    }
    /*
    else if(c[0]=='I') {
      //send("I "+i);
      int brightness=Serial.parseInt();
    }
    */
    else if(c[0]=='L') {
      //send("L "+row1+" "+col1+" "+row2+" "+col2+" "+r+" "+g+" "+b);
      int row1=Serial.parseInt();
      int col1=Serial.parseInt();
      int row2=Serial.parseInt();
      int col2=Serial.parseInt();
      int r=Serial.parseInt();
      int g=Serial.parseInt();
      int b=Serial.parseInt();
      int f=Serial.parseInt();
      drawLine(row1, col1, row2, col2, r, g, b);
    }
    else if(c[0]=='S') {
      //send("S "+n+" "+col+" "+row+" "+r+" "+g+" "+b+" "+new String(c));
      int count=Serial.parseInt();
      int row=Serial.parseInt();
      int col=Serial.parseInt();
      int r=Serial.parseInt();
      int g=Serial.parseInt();
      int b=Serial.parseInt();
      char text[count];
      Serial.readBytes(text, 1);//absorbs space
      /*int n2=*/Serial.readBytes(text, count);
      /*
      if(n!=n2) {
        Serial.write('S');
      }
      */
      drawString(count, row, col, r, g, b, text);
    }
  }
}
  


const static int ROWS = 44;
const static int COLS = 74;
static int colmax = 73;


 int toLEDNum(int row, int col) { //The original LED num method. This is still vital.
  int output = 0;
  if (row % 2 == 0) {
    output = (row * colmax) + (row + col);
  }
  else {
    output = (row * colmax) + ((colmax - col) + row);
  }
  return output;
}




///////////////////////////////////////////////////PIXEL
void setPixel(int row, int col, int r, int g, int b)
{
  colorPixel(row, col, r, g, b);
}

void colorPixel(int row, int col, int r, int g, int b)
{
  if (row < 0 || row >= ROWS || col < 0 || col >= COLS)
  {
    return;
  }
  int led = toLEDNum(row, col);
  strip.setPixelColor(led, r, g, b);
}



void clear()
{
  colorRect(0, 0, COLS, ROWS, 0, 0, 0, true);
}

//////////////////////////////////////////////////////////////////////////////Line
void drawLine(int r1, int c1, int r2, int c2, int red, int green, int blue) {
  // Draw line using RGB
  int deltC = c2 - c1;
  int deltR = r2 - r1;
  double slope = (double) deltR / deltC;

  double c = min(c1, c2);
  double r = min(r1, r2);

  if (slope > -1 && slope < 1) {
    if (min(c1, c2) == c2) {
      r = r2;
    }
    else {
      r = r1;
    }
    if (min(r1, r2) == r2) {
      c = c2;
    }
    else {
      c = c1;
    }
    for (int c3 = min(c1, c2); c3 <= max(c1, c2); c3++) {
      r = r + slope;
      setPixel((int)r, c3, red, green, blue);
    }

  }
  else {
    if (min(c1, c2) == c2) {
      r = r2;
    }
    else {
      r = r1;
    }
    if (min(r1, r2) == r2) {
      c = c2;
    }
    else {
      c = c1;
    }
    for (int r3 = min(r1, r2); r3 <= max(r1, r2); r3++) {
      c = c + 1 / slope;
      setPixel(r3, (int)c, red, green, blue);
    }
  }
}

///////////////////////////////////////////////////////////////Rect
void colorRect(int row, int col, int width, int height, int r, int g, int b, boolean solid)
{
  if (solid == false)
  {
    drawLine(row, col, row + height, col, r, g, b);
    drawLine(row, col, row, col + width, r, g, b);
    drawLine(row + height, col, row + height, col + width, r, g, b);
    drawLine(row, col + width, row + height, col + width, r, g, b);
  }
  else
  {
    int finalRow = row + height;

    if (finalRow >= ROWS)
    {
      finalRow = ROWS - 1;
    }
    int finalCol = col + width;
    if (finalCol >= COLS)
    {
      finalCol = COLS - 1;
    }
    for (int rw = row; rw <= finalRow; rw++)
    {
      for (int cl = col; cl <= finalCol; cl++)
      {
        colorPixel(rw, cl, r, g, b);
      }
    }
  }
}

////////////////////////////////////////////////CIRCLE
void drawCircle(int x, int y, int r, int red, int green, int blue, boolean fill)
{
  double i, angle, x1, y1;
  if (fill == false)
  {
    for (i = 0; i < 360; i += 1)
    {
      angle = i;
      x1 = r * cos(angle * PI / 180);
      y1 = r * sin(angle * PI / 180);

      int ElX = (int) (x + x1 + 0.5);
      int ElY = (int) (y + y1 + 0.5);

      setPixel(ElX, ElY, red, green, blue);
    }
  }
  else
  {
    for (int j = r; j >= 0; j--)
    {
      for (i = 0; i < 360; i += 1)
      {
        angle = i;
        x1 = j * cos(angle * PI / 180);
        y1 = j * sin(angle * PI / 180);

        int ElX = (int) (x + x1 + 0.5);
        int ElY = (int) (y + y1 + 0.5);

        setPixel(ElX, ElY, red, green, blue);
      }
    }
  }
}

//////////////////////////////////////////////////////////////////////////////////TEXT
void drawString(int n, int row, int col, int red, int green, int blue, String chars) {
  char charset[256][6]  = {
    {0x00, 0x00, 0x00, 0x00, 0x00, 0x00}, //   0x 0 0
    {0x00, 0x64, 0x18, 0x04, 0x64, 0x18}, // 0x 1 1
    {0x00, 0x3c, 0x40, 0x40, 0x20, 0x7c}, // 0x 2 2
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    {0x00, 0x00, 0x00, 0x00, 0x00, 0x00}
  };
  int extraSpacing = 0; // extra spacing between letters

  for (int i = 0; i < n; i++)
  { // for each character in "chars"...
    char letter = chars.charAt(i); // get corresponding letter
    //Serial.print("" + letter.toInt());
    char locs[6] = {};
    memcpy(locs, charset[letter], 6); //array of hex codes for each row of pixels in the letter
    //      System.out.println("L: " + letter + "; HC: " + letter.hashCode());
    if (letter == 32)//if the character is a space (" ")...
    {
      extraSpacing -= 3;//reduce the spacing
    }
    for (int c = 0; c < sizeof(locs); c++) // for each column...
    {
      int r = 0; // intialized row count
      for (int j = 1; j <= 256; j *= 2) // for each pixel/binary in the row...
      {
        if (((locs[c]) & j) != 0) //if the pixel should be on...
        {

          setPixel(r + row, c + col + extraSpacing, red, green, blue);//turn the pixel on
        }

        r++;//increase the row count
      }
    }
    extraSpacing += 6; //add spacing between letters
  }

}